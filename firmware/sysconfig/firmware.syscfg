/**
 * @cliArgs --board "/ti/boards/LP_MSPM0L2228" --product "mspm0_sdk@2.09.00.00"
 * @versions {"tool":"1.26.2+4477"}
 */

/**
 * Import the modules used in this configuration.
 */
const SYSCTL        = scripting.addModule("/ti/driverlib/SYSCTL");
const TRNG          = scripting.addModule("/ti/driverlib/TRNG");
const UART          = scripting.addModule("/ti/driverlib/UART", {}, false);
const UART1         = UART.addInstance();
const UART2         = UART.addInstance();
const WWDT          = scripting.addModule("/ti/driverlib/WWDT", {}, false);
const WWDT1         = WWDT.addInstance();
const ProjectConfig = scripting.addModule("/ti/project_config/ProjectConfig");

/**
 * Write custom configuration values to the imported modules.
 */
SYSCTL.BORThresh = "3";

const Board = scripting.addModule("/ti/driverlib/Board", {}, false);

TRNG.decimationRate = "DL_TRNG_DECIMATION_RATE_8";

UART1.targetBaudRate                   = 115200;
UART1.enableFIFO                       = true;
UART1.enableDMARX                      = false;
UART1.enableDMATX                      = false;
UART1.$name                            = "HOST";
UART1.rxFifoThreshold                  = "DL_UART_RX_FIFO_LEVEL_ONE_ENTRY";
UART1.txFifoThreshold                  = "DL_UART_TX_FIFO_LEVEL_ONE_ENTRY";
UART1.enabledInterrupts                = ["BREAK_ERROR","FRAMING_ERROR","OVERRUN_ERROR"];
UART1.peripheral.rxPin.$assign         = "boosterpack.29";
UART1.peripheral.txPin.$assign         = "boosterpack.30";
UART1.txPinConfig.$name                = "ti_driverlib_gpio_GPIOPinGeneric0";
UART1.txPinConfig.direction            = scripting.forceWrite("OUTPUT");
UART1.txPinConfig.hideOutputInversion  = scripting.forceWrite(false);
UART1.txPinConfig.onlyInternalResistor = scripting.forceWrite(false);
UART1.txPinConfig.passedPeripheralType = scripting.forceWrite("Digital");
UART1.rxPinConfig.$name                = "ti_driverlib_gpio_GPIOPinGeneric1";
UART1.rxPinConfig.hideOutputInversion  = scripting.forceWrite(false);
UART1.rxPinConfig.onlyInternalResistor = scripting.forceWrite(false);
UART1.rxPinConfig.passedPeripheralType = scripting.forceWrite("Digital");

UART2.$name                            = "HSM";
UART2.targetBaudRate                   = 115200;
UART2.enableFIFO                       = true;
UART2.rxFifoThreshold                  = "DL_UART_RX_FIFO_LEVEL_ONE_ENTRY";
UART2.txFifoThreshold                  = "DL_UART_TX_FIFO_LEVEL_ONE_ENTRY";
UART2.enabledInterrupts                = ["OVERRUN_ERROR"];
UART2.peripheral.rxPin.$assign         = "boosterpack.3";
UART2.peripheral.txPin.$assign         = "boosterpack.4";
UART2.txPinConfig.$name                = "ti_driverlib_gpio_GPIOPinGeneric2";
UART2.txPinConfig.direction            = scripting.forceWrite("OUTPUT");
UART2.txPinConfig.hideOutputInversion  = scripting.forceWrite(false);
UART2.txPinConfig.onlyInternalResistor = scripting.forceWrite(false);
UART2.txPinConfig.passedPeripheralType = scripting.forceWrite("Digital");
UART2.rxPinConfig.$name                = "ti_driverlib_gpio_GPIOPinGeneric3";
UART2.rxPinConfig.hideOutputInversion  = scripting.forceWrite(false);
UART2.rxPinConfig.onlyInternalResistor = scripting.forceWrite(false);
UART2.rxPinConfig.passedPeripheralType = scripting.forceWrite("Digital");

WWDT1.$name             = "WWDT0";
WWDT1.periodCount       = "15";
WWDT1.interruptPriority = "0";
WWDT1.sleepMode         = true;

ProjectConfig.genStartup = false;
ProjectConfig.genOpts    = false;
ProjectConfig.genLibs    = false;
ProjectConfig.genLinker  = false;
ProjectConfig.compiler   = "ticlang";

/**
 * Pinmux solution for unlocked pins/peripherals. This ensures that minor changes to the automatic solver in a future
 * version of the tool will not impact the pinmux you originally saw.  These lines can be completely deleted in order to
 * re-solve from scratch.
 */
SYSCTL.peripheral.$suggestSolution         = "SYSCTL";
Board.peripheral.$suggestSolution          = "DEBUGSS";
Board.peripheral.swclkPin.$suggestSolution = "j14_expansion.15";
Board.peripheral.swdioPin.$suggestSolution = "j14_expansion.13";
UART1.peripheral.$suggestSolution          = "UART0";
UART2.peripheral.$suggestSolution          = "UART1";
WWDT1.peripheral.$suggestSolution          = "WWDT0";
